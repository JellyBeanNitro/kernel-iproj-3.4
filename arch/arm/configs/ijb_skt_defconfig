## lge/com_device/power/Kconfig
```kconfig
#platform.team@lge.com	2011.01

comment "LGE PM selection"

config LGE_PM
	bool "Power Manage, Battery charging, gaguging in PM8508 PM8901"
	default y
	---help---
	LGE PM related change

config LGE_PMIC8058_REGULATOR
	depends on ARCH_MSM8X60
	default y
	bool "LGE PMIC8058 REGULATOR Configuration"
	help
		LGE PMIC8058 REGULATOR Configuration

config LGE_PMIC8901_REGULATOR
	depends on ARCH_MSM8X60
	default y
	bool "LGE PMIC8901 REGULATOR Configuration"
	help
		LGE PMIC8901 REGULATOR Configuration

config LGE_PMIC8058_GPIO
	depends on ARCH_MSM8X60
	default y
	bool "LGE PMIC8058 GPIO Configuration"
	help
		LGE PMIC8058 GPIO Configuration

config LGE_PMIC8058_KEYPAD
	depends on ARCH_MSM8X60
	default y
	bool "LGE PMIC8058 KEYPAD Configuration"
	help
		LGE PMIC8058 KEYPAD Configuration

config LGE_PMIC8058_MPP
	depends on ARCH_MSM8X60
	default y
	bool "LGE PMIC8058 MPP Configuration"
	help
		LGE PMIC8058 MPP Configuration
		
config LGE_PMIC8058_TM
	depends on ARCH_MSM8X60
	default y
	bool "LGE PMIC8058 TM Configuration"
	help
		LGE PMIC8058 TM Configuration

config LGE_FUEL_GAUGE
	depends on ARCH_MSM8X60
	default y
	bool "LGE FUEL GAUGE Configuration"
	help
		LGE FUEL GUAGE Configuration		

config LGE_CHARGER_VOLTAGE_CURRENT_SCENARIO
	depends on ARCH_MSM8X60
	default y
	bool "LGE CHARGER VOLTAGE/CURRENT SCENARIO Configuration"
	help
		LGE CHARGER VOLTAGE/CURRENT SCENARIO Configuration

config LGE_CHARGER_TEMP_SCENARIO
	depends on ARCH_MSM8X60
	default y
	bool "LGE CHARGER TEMP SCENARIO Configuration"
	help
		LGE CHARGER TEMP SCENARIO Configuration

config LGE_WIRELESS_CHARGER_MAX8971
        depends on ARCH_MSM8X60
        default n
        bool "LGE WIRELESS Charger MAX8971 Configuration"
        help
                LGE WIRELESS Charger MAX8971 Configuration

config LGE_WIRELESS_CHARGER_BQ24160
	depends on ARCH_MSM8X60
	default y
	bool "LGE WIRELESS Charger BQ24160 Configuration"
	help
		LGE WIRELESS Charger BQ24160 Configuration

config LGE_MDM_PMIC_8028
	depends on ARCH_MSM8X60
	default y
	bool "LGE MDM PMIC enable control"
	help
		LGE MDM PMIC enable control Configuration

config LGE_BOARD_GPIO
	default n
	bool "LGE GPIO configuration" 
	help
		LGE GPIO Configuration
choice
	prompt "LGE gpio configs for each board"
	default LGE_I_REV_B_GPIO

config LGE_I_REV_B_GPIO
	bool "LGE_I_REV_B_GPIO"
	depends on LGE_BOARD_GPIO
	help
	  LGE gpio config for board rev B.

config LGE_I_REV_C_GPIO
	bool "LGE_I_REV_C_GPIO"
	depends on LGE_BOARD_GPIO
	help
	  LGE gpio config for board rev C.

config LGE_I_REV_D_GPIO
	bool "LGE_I_REV_D_GPIO"
	depends on LGE_BOARD_GPIO
	help
	  LGE gpio config for board rev D.
endchoice

config LGE_I_POWER_KPROBE_DEBUG
	depends on ARCH_MSM8X60
	default n
	bool "KPROBE debug module"
	help
		LGE I Prj kprobe debug module

config LGE_PM_BATTERY_ID_CHECKER
        depends on ARCH_MSM8X60
        default y
        bool "LGE PM BATTERY ID CHECKER"
        help
                LGE PM Battery Id Checker Configuration
                
config LGE_PM_CURRENT_CABLE_TYPE
        depends on ARCH_MSM8X60
        default y
        bool "LGE PM CURRENT CABLE TYPE"
        help
                LGE PM Set Current Cable Type Configuration

config LGE_AT_COMMAND_ABOUT_POWER
        depends on ARCH_MSM8X60
        default y
        bool "LGE AT COMMAND ABOUT POWER"
        help
                LGE AT Command about power Configuration

config LGE_BATT_SOC_FOR_NPST
        depends on ARCH_MSM8X60
        default y
        bool "LGE BATTERY SOC FOR DOWNLOAD"
        help
                LGE Battery Soc for download to prevent download with low battery Configuration

config LGE_PM_BATTERY_ALARM
	depends on ARCH_MSM8X60
	default y
	bool "LGE PM8058 BATTERY ALARM"
	help
		LGE PM8058 BATTERY ALARM Configuration


config LGE_PM_POWER_OFF_SCENARIO
	depends on ARCH_MSM8X60
	default y
	bool "LGE POWER OFF SCENARIO"
	help
		LGE Power Off Scenario configuration in android side

config LGE_PM_CURRENT_CONSUMPTION_FIX
	depends on ARCH_MSM8X60
	default y
	bool "LGE CURRENT CUNSUMPTION FIX"
	help
		LGE Current Consumption Fix	

config LGE_SWITCHING_CHARGER_BQ24160_DOCOMO_ONLY
	depends on MACH_LGE_I_BOARD_DCM
	default y
	bool "LGE SWITCHING Charger TI BQ24160 Configuration"
	help
		LGE SWITCHING Charger TI BQ24160 Configuration

config LGE_PM_POWER_RTC_ALARM_OFF
  depends on ARCH_MSM8X60
  default y
  bool "LGE RTC ALARM OFF FIX"
  help
    LGE RTC ALARM bug fix configuration in android side
    
config LGE_PM_TEMPERATURE_MONITOR
  depends on ARCH_MSM8X60
  default y
  bool "LGE TEMPERATURE MONITOR"
  help
    LGE temperature monitoring on sleep mode

config LGE_PM_FACTORY_CURRENT_DOWN
  depends on ARCH_MSM8X60
  default y
  bool "LGE FACTORY CURRENT DOWN"
  help
    LGE current down in factory   

config LGE_PM_FACTORY_FUEL_GAUGE
  depends on ARCH_MSM8X60
  default y
  bool "LGE PM FACTORY FUEL_GAUGE"
  help
    LGE SKIP fuel gauge i2c in factory

config LGE_PM_PLATFORM_BSP_DEBUG
  depends on ARCH_MSM8X60
  default n
  bool "LGE PLATFORM BSP DEBUG"
  help
    LGE debug platform-bsp   
```

## lge/factory/Kconfig
```kconfig
#platform.team@lge.com	2011.01

config LGE_FACTORY
	default y
	bool "LGE factory Configuration"
	help
		LGE factory Configuration

config LGE_ERROR_HANDLER
	default y
	bool "LGE error handler"
	help
		Enable LGE error handler

config LGE_HANDLE_PANIC
	default n
	depends on LGE_ERROR_HANDLER
	bool "LGE error handler"
	help
		Enable LGE error handler

config LGE_HIDDEN_RESET_PATCH
	depends on LGE_ERROR_HANDLER
	default n
	bool "LGE hidden reset"
	help
	  Enable LGE hidden reset
	  
config LGE_SILENT_RESET_PATCH
	depends on LGE_ERROR_HANDLER
	default y
	bool "LGE silent reset"
	help
	  Enable LGE silent reset

config LGE_SUPPORT_RAPI
	depends on LGE_FACTORY
	default y
	bool "LGE Remote communcation api support"
	help
		LGE Remote communcation api support

config LGE_DIAGTEST
	depends on LGE_FACTORY
	default y
	bool "LGE TestMode Diag Support"
	help
		LGE TestMode Diag Supports

config LGE_DIAG_KEYPRESS
	depends on LGE_DIAGTEST
	default y
	bool "LGE UTS KEYPRESS Support"
	help
		LGE UTS KEYPRESS Supports

config LGE_DIAG_UDM
	depends on LGE_FACTORY
	default y
	bool "LGE UDM Support"
	help
		LGE UDM Supports

config LGE_DIAG_SCREENSHOT
	depends on LGE_FACTORY
	default y
	bool "LGE UTS SCREENSHOT Support"
	help
		LGE UTS SCREENSHOT Supports

config LGE_DLOAD_SRD
	depends on LGE_FACTORY
	default y
	bool "LGE Dload SelfRecoveryDownload Support"
	help
		LGE Dload SelfRecoveryDownload Support

config LGE_EMMC_DIRECT_ACCESS
	depends on LGE_DIAGTEST
	default y
	bool "LGE eMMC direct access driver"
	help
                LGE eMMC direct access driver

config LGE_MANUAL_TEST_MODE
        depends on LGE_FACTORY
        default y
        bool "LGE Manual Test Mode Support"
        help
                LGE Manual Test Mode Support

config LGE_SMS_PC_TEST
	depends on LGE_DIAGTEST
        default n
        bool "LGE CONFIG_LGE_SMS_PC_TEST Support"
        help
                LGE CONFIG_LGE_SMS_PC_TEST Support

config LGE_DIAG_ERI
        depends on LGE_FACTORY
        default n
        bool "LGE ERI Diag Support"
        help
                LGE ERI Diag Support

config LGE_ERI_DOWNLOAD
	depends on LGE_DIAGTEST
        default n
        bool "LGE ERI Download Support"
        help
                LGE ERI Download Support

config LGE_DID_BACKUP
	depends on LGE_DIAGTEST
        default y
        bool "LGE DID Backup Support"
        help
                LGE DID Backup Support

config LGE_VOLD_SUPPORT_CRYPT
	depends on LGE_DIAGTEST
        default n
        bool "LGE VOLD Crypt Support"
        help
                LGE VOLD Crypt Support

config LGE_KERNEL_ROOTING_NV_INTERFACE
	depends on LGE_DIAGTEST
        default n
        bool "LGE Kernel Rooting NV Interface Support"
        help
                LGE Kernel Rooting NV Interface Support
```

## lge/lge_board/Kconfig
```kconfig
config MACH_LGE_I_BOARD
       bool "LGE_I_BOARD"
       depends on ARCH_MSM8X60
       default n
       ---help---
         LGE I-project. 

choice
	prompt "LGE board type"
	default MACH_LGE_IJB_BOARD_SKT

config MACH_LGE_IJB_BOARD_SKT
       bool "LGE_IJB_BOARD_SKT"
       depends on MACH_LGE_I_BOARD
       ---help---
         LGE IJB-project for SKT.         

endchoice
```
