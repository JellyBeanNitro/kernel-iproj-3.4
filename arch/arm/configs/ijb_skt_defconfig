## drivers/broadcast/tdmb/Kconfig
```kconfig
#
# Broadcast Device Driver Support
#

#menu "BROADCAST_DEVICE"

config LGE_BROADCAST_TDMB_FC8050
	bool "LGE broacast TDMB FC8050 device"
	default y
	depends on (LGE_BROADCAST_TDMB&&(MACH_LGE_325_BOARD_SKT || MACH_LGE_325_BOARD_LGU || MACH_LGE_120_BOARD || MACH_LGE_IJB_BOARD_SKT || MACH_LGE_IJB_BOARD_LGU ))
	help
	  Select this if you want to use broadcast service
	  
#endmenu
```

## drivers/net/wireless/bcmdhd_b2/Kconfig
```kconfig
config BCMDHD_B2
	tristate "Broadcom 4330 B2 wireless cards support"
	depends on MMC
	---help---
	  This module adds support for wireless adapters based on
	  Broadcom 4329/30 chipset.
	  This driver uses the kernel's wireless extensions subsystem.
	  If you choose to build a module, it'll be called dhd. Say M if
	  unsure.

config BCMDHD_FW_PATH
	depends on BCMDHD_B2
	string "Firmware path"
	default "/system/etc/firmware/fw_bcmdhd.bin"
	---help---
	  Path to the firmware file.

config BCMDHD_NVRAM_PATH
	depends on BCMDHD_B2
	string "NVRAM path"
	default "/system/etc/wifi/bcmdhd.cal"
	---help---
	  Path to the calibration file.

config BCMDHD_WEXT
	bool "Enable WEXT support"
	depends on BCMDHD_B2 && CFG80211 = n
	select WIRELESS_EXT
	select WEXT_PRIV
	---help---
	  Enables WEXT support

config LGE_BCM432X_PATCH
	bool "BCM432X Patch by LGE"
	default y
	depends on BCMDHD_B2

config BCMDHD_CONFIG_PATH
	depends on LGE_BCM432X_PATCH
	string "Config path"
	default "/data/misc/wifi/config"
	---help---
	  Path to the config file.

config BCMDHD_GPIO_WL_RESET
	depends on BCMDHD_B2
	int "GPIO to the Reset"
	default 34 
	---help---
	  GPIO to the Reset

config BCMDHD_HOSTWAKEUP_USE_GPIO
	depends on BCMDHD_B2
	bool "Use GPIO to Host Wakeup"
	select BCMDHD_HW_OOB
	---help---
	  Use GPIO to Host Wakeup

config BCMDHD_HOSTWAKEUP_USE_SDIO
	depends on BCMDHD_B2 && BCMDHD_HOSTWAKEUP_USE_GPIO = n
	bool "Use SDIO pin to the Host Wakeup"
	---help---
	  Use SDIO pin to the Host Wakeup

config BCMDHD_GPIO_WL_HOSTWAKEUP
	depends on BCMDHD_B2 && BCMDHD_HOSTWAKEUP_USE_GPIO = y
	int "GPIO to the Host Wakeup"
	default 45
	---help---
	  GPIO to the Host Wakeup

config BCMDHD_HW_OOB
	depends on BCMDHD_B2 && BCMDHD_HOSTWAKEUP_USE_GPIO = y         
	bool "Use H/W OOB to the Host Wakeup"
	default n
	---help---
	  Use H/W OOB to the Host Wakeup

config BCMDHD_USE_STATIC_BUF
	depends on BCMDHD_B2
	bool "Use static buffer in os_malloc"
	default n
	---help---
	  Use static buffer in os_malloc
```

## lge/com_device/audio/Kconfig
```kconfig
#platform.team@lge.com	2011.01

config LGE_AUDIO
	default y
	bool "LGE Audio Configuration"
	help
		LGE AUDIO Configuration

# Audio driver configuration
comment "Audio driver Selection"

config LGE_AUDIO_AMP_WM9093
        bool "Audio subsystem WM9093"
        default y
        ---help---
                Wolfson microelectronics Ultra Low power Audio subsystem

config LGE_AUDIO_AMP_WM9093_CHECK_REGISTER_VALUE_BY_REREADING
       	depends on LGE_AUDIO_AMP_WM9093
        default n
        bool "Audio subsystem WM9093 checking register feature"
        ---help---
                check register value by rereading after writing

config LGE_AUDIO_WM9093_POPNOISE
		bool "Audio subsystem WM9093 Pop Noise"
		default n
		---help---
				LGE : Reduce Wofson Pop noise               
```

## lge/com_device/camera/Kconfig
```kconfig
config LGE_CAMERA
	default y
	bool "LGE Camera Configuration"
	help
		LGE CAMERA Configuration


comment "Camera Sensor Selection"

config LGE_SENSOR_IMX105
	bool "Sensor IMX105 8MP MIPI (BAYER 8M)"
	depends on LGE_CAMERA && ARCH_MSM8X60
	default y
	---help---
	SONY 8M Bayer MIPI Sensor with Autofocus
	  	  
config LGE_SENSOR_MT9M114
	bool "Sensor MT9M114 1.26MP MIPI (SOC 1.26M)"
	depends on LGE_CAMERA && ARCH_MSM8X60
	default y
	---help---
	APTINA 1.26M SOC MIPI Sensor without Autofocus	

comment "Camera flash Selection"
	  	  
config LGE_FLASH_LM3559
	bool "LM3559 flash support"
	#depends on LGE_CAMERA && ARCH_MSM8X60
	default y
	---help---
	  Enable support for LM3559 flash for msm camera
```

## lge/com_device/display/Kconfig
```kconfig
menu "Device Drivers"

config LGE_BACKLIGHT_LM3530
	bool "select lm3530 device as LGE backlight management for I "
	default y
	---help---
	LGE backlight management (lm3530)

config LGE_DISPLAY_MIPI_LGIT_IJB_VIDEO_HD_PT
	bool "LGE_DISPLAY_MIPI_LGIT_IJB_VIDEO_HD_PT"
	select FB_MSM_MIPI_DSI
	---help---
	LGE display management

endmenu

menu "Features"

config LGE_I_DISP_FBREAD
	bool "enable msm_fb_read"
	default y
	---help---
	select this feature if you want to dump framebuffer

config LGE_I_DISP_EARLYSUSPEND
	bool "enable LCD early suspend"
	default y
	---help---
	select this feature if you want to enable LCD early suspend

config LGE_I_DISP_UNDERRUN
	bool "prevent under-run during video play"
	default y
	---help---
	select this feature for preventing under-run issue

config LGE_I_DISP_PHYSIZE
	bool "hard-coding for LCD physical size"
	default y
	---help---
	select this feature for fb_info.var.width=56, fb_info.var.height=99

config LGE_I_DISP_HSMODE
	bool "MIPI clk High Speed mode"
	default y
	---help---
	select this feature for HM mode MIPI clock

config LGE_I_DISP_OVERLAYUI
	bool "patch for overlay UI"
	default y
	---help---
	select this feature for overlay UI

config LGE_I_DISP_BOOTLOGO
	bool "enable bootlogo in kernel"
	default y
	---help---
	select this feature for kernel bootlogo

config LGE_I_DISP_OV_MUTEX
	bool "fix overlay lock-up issue"
	default y
	---help---
	select this feature for resolving overlay lock-up issue

config LGE_SHOW_FB_BOOTLOGO
	bool "Display boot animation from the frame buffer driver, for batman domestic models only"
	default n
	depends on MACH_LGE_120_BOARD
	---help---
	Select this feature to show boot animation from the frame buffer driver

endmenu
```

## lge/com_device/input/Kconfig
```kconfig
# Sensor driver configuration
comment "Sensor driver Selection"
config LGE_SENSOR
	default y
	bool "LGE Sensor Devices Common Configuration"
	help
		LGE Sensor Devices Common Configuration

config LGE_SENSOR_FUSION
	default y
	bool "LGE Sensor Fusion Configuration"
	help
		LGE Sensor Fusion Configuration

config LGE_SENSOR_ACCELEROMETER
	default y
	bool "LGE Accelerometer STM K3DH Configuration"
	help
		LGE Accelerometer STM K3DH Configuration
		
config LGE_SENSOR_GYROSCOPE
	default y
	bool "LGE Gyroscope STM K3GTR Configuration"
	help
		LGE Gyroscope STM K3GTR Configuration		
		
config LGE_SENSOR_DCOMPASS
	default y
	bool "LGE Digital Compass AICHI AMI306 Configuration"
	help
		LGE Digital Compass  AICHI AMI306 Configuration		

config LGE_SENSOR_PROXIMITY
	tristate "APDS9900 based proximity and light sensor"
	help
	  Say Y here if you have a sensor interface using the
	  APDS9900 controller, and your board-specific
	  setup code includes i2c devices.

	  If unsure, say N (but it's safe to say "Y").
config LGE_SENSOR_GP2AP
	tristate "GP2AP based proximity sensor"
	help
	  Say Y here if you have a sensor interface using the
	  GP2AP controller, and your board-specific
	  setup code includes i2c devices.

	  If unsure, say N (but it's safe to say "Y").

	  To compile this driver as a module, choose M here: the
	  module will be called ads7846.

config LGE_SENSOR_KR3DH
	tristate "KR3DH based accelerometer sensor"
	help
	  Say Y here if you have a sensor interface using the
	  KR3DH controller, and your board-specific
	  setup code includes i2c devices.

	  If unsure, say N (but it's safe to say "Y").

	  To compile this driver as a module, choose M here: the
	  module will be called ads7846.

config LGE_SENSOR_KR3DM
	tristate "8bit accel data for KR3DM"
	help
	  Say Y here if you have a sensor interface using the
	  KR3DM controller, and your board-specific
	  setup code includes i2c devices.

	  If unsure, say N (but it's safe to say "Y").
	  
config LGE_SENSOR_AK8973
	tristate "AK8973 based ecompass sensor"
	help
	  Say Y here if you have a sensor interface using the
	  AK8973 controller, and your board-specific
	  setup code includes i2c devices.

	  If unsure, say N (but it's safe to say "Y").

	  To compile this driver as a module, choose M here: the
	  module will be called ads7846.

config LGE_SENSOR_AMI304
        tristate "AMI304 based gyro sensor"
        help
          Say Y here if you have a sensor interface using the
          AMI304 controller, and your board-specific
          setup code includes i2c devices.

          If unsure, say N (but it's safe to say "Y").

config LGE_HEADSET_DETECTION_FSA8008
        tristate "Fairchild  FSA8008 headset detection"
        help
          This enables support for Fairchild  FSA8008 headset detection.          
          
config LGE_TOUCHSCREEN_MELFAS
        tristate "MELFAS touchscreen driver"
        depends on I2C
        help
        Say Y here if you have a MELFAS touchscreen.

        If unsure, say N.

config LGE_TOUCH_MELFAS_ISC
	bool "TM1940"
	depends on LGE_TOUCHSCREEN_MELFAS
	help
         Register map TM1940.

config LGE_TOUCH_MELFAS_ISP
	bool "TM1940"
	depends on LGE_TOUCHSCREEN_MELFAS
	help
         Register map TM1940.

config LGE_TOUCHSCREEN_SYNAPTICS_RMI4_I2C
	tristate "Synaptics RMI4 protocol based I2C interface Touchscreen Driver"
	help
	  This enables support for Synaptics RMI4 protocol I2C interface Touchscreens.               
choice
	prompt "Register map"
	depends on LGE_TOUCHSCREEN_SYNAPTICS_RMI4_I2C

config LGE_TOUCH_REG_MAP_TM1804
	bool "TM1804"
	depends on LGE_TOUCHSCREEN_SYNAPTICS_RMI4_I2C && MACH_LGE_I_BOARD_VZW
	help
         Register map TM1804. 

 config LGE_TOUCH_REG_MAP_TM1898
	bool "TM1898"
	help
         Register map TM1898. use for cayman mpcs
         
 config LGE_TOUCH_REG_MAP_TM1992
	bool "TM1992"
	help
         Register map TM1992. use for cayman vzw

config LGE_TOUCH_REG_MAP_TM1814
	bool "TM1814"
	depends on LGE_TOUCHSCREEN_SYNAPTICS_RMI4_I2C && MACH_LGE_IJB_BOARD_SKT
	help
         Register map TM1814. 

config LGE_TOUCH_REG_MAP_TM1995
	bool "TM1995"
	depends on LGE_TOUCHSCREEN_SYNAPTICS_RMI4_I2C  && (MACH_LGE_I_BOARD_LGU || MACH_LGE_I_BOARD_DCM ||MACH_LGE_IJB_BOARD_LGU)
	help
         Register map TM1995. 
endchoice

config LGE_TOUCH_CHAGER_CTRL
	default y
	bool "Synaptics Charger Control"
	depends on LGE_TOUCHSCREEN_SYNAPTICS_RMI4_I2C && MACH_LGE_I_BOARD
	help
	  This enables charger contrl for Synaptics.               

config LGE_TOUCHSCREEN_CORE_IJB
	tristate "LG touchscreen core driver for IJB"
        depends on I2C && MACH_LGE_I_BOARD
        help
        Say Y here if you LG.

        If unsure, say N.

config LGE_TOUCH_SYNAPTICS_IJB
        tristate "IJB Synaptics touchscreen driver"
        depends on I2C && MACH_LGE_I_BOARD
	help
        Say Y here if you have a Synaptics touchscreen.

        If unsure, say N.

config LGE_TOUCH_SYNAPTICS_IJB_FW_UPGRADE
	bool "Synaptics ClearPad IJB F/W upgrade"
	depends on LGE_TOUCHSCREEN_SYNAPTICS_RMI4_I2C
	help
	  This enables support for Synaptics general F/W upgrade.
```
